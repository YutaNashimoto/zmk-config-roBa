## Kconfig
```kconfig
# ホストOS判定（USB有線時のみ）。有効化しない限り何もビルドされない。
config ZMK_OS_DETECTION
	bool "Detect host OS over USB and switch default layer"
	default n
	depends on ZMK_USB
	select USB_DEVICE_OS_DESC

if ZMK_OS_DETECTION

config ZMK_OS_DETECTION_DEBOUNCE_MS
	int "Debounce time (ms) after last string descriptor request"
	default 400

config ZMK_OS_DETECTION_LAYER_MACOS
	int "Default layer for macOS"
	default 0

config ZMK_OS_DETECTION_LAYER_IOS
	int "Default layer for iOS/iPadOS"
	default 1

config ZMK_OS_DETECTION_LAYER_WINDOWS
	int "Default layer for Windows"
	default 16

config ZMK_OS_DETECTION_LAYER_LINUX
	int "Default layer for Linux"
	default 16

config ZMK_OS_DETECTION_REVERT_ON_DISCONNECT
	bool "Revert to disconnect layer when USB is unplugged"
	default y

config ZMK_OS_DETECTION_DISCONNECT_LAYER
	int "Layer to revert to on USB disconnect"
	default 0

endif

# BLEプロファイル番号を機器名に反映（roBa_1, roBa_2 ...）
config ZMK_BLE_PROFILE_NAME
	bool "Append active BLE profile number to the advertised device name"
	default n
	depends on ZMK_BLE

config ZMK_BLE_PROFILE_NAME_PREFIX
	string "Device name prefix used before the profile number"
	default "roBa"
	depends on ZMK_BLE_PROFILE_NAME
```

## config/west.yml
```yaml
manifest:
  remotes:
    - name: zmkfirmware
      url-base: https://github.com/zmkfirmware
    - name: yutanashimoto
      url-base: https://github.com/YutaNashimoto
  projects:
    - name: zmk
      remote: zmkfirmware
      revision: v0.3-branch
      import: app/west.yml
    - name: zmk-pmw3610-driver
      remote: yutanashimoto
      repo-path: zmk-config-roBa
      # roBa用fork: MOTION有効ビットの検証とSPI失敗時のCS解放を追加。
      revision: c8bdbafdd03552c3790f24792157bfe32178348a
  self:
    path: config
```

## dts/bindings/behaviors/zmk,behavior-alfred-smart.yaml
```yaml
description: Launch Cmd+Space/Ctrl+Space based on the currently active OS default layer

compatible: "zmk,behavior-alfred-smart"

include: zero_param.yaml
```

## dts/bindings/behaviors/zmk,behavior-cmd-mo.yaml
```yaml
description: Hold Right-GUI (Cmd) and momentarily activate a layer
compatible: "zmk,behavior-cmd-mo"

include: one_param.yaml
```

## dts/bindings/behaviors/zmk,behavior-ctrl-mo.yaml
```yaml
description: Hold Right-Control and momentarily activate a layer (Windows)

compatible: "zmk,behavior-ctrl-mo"

include: one_param.yaml
```

## dts/bindings/behaviors/zmk,behavior-hold-mod.yaml
```yaml
description: Hold a modifier via direct HID registration (bypasses the hold-tap capture/replay path)

compatible: "zmk,behavior-hold-mod"

include: one_param.yaml
```

## dts/bindings/behaviors/zmk,behavior-nomod.yaml
```yaml
description: Send a key with the cmd_mo-held modifier temporarily removed

compatible: "zmk,behavior-nomod"

include: one_param.yaml
```

## dts/bindings/behaviors/zmk,behavior-to-base-keep-cpi.yaml
```yaml
description: Like &to but preserves the CHANGE_CPI (precision) layer state
compatible: "zmk,behavior-to-base-keep-cpi"

include: one_param.yaml
```

## dts/bindings/behaviors/zmk,behavior-toggle-lshift.yaml
```yaml
description: Toggle Left-Shift held/released (like &tog, but for a modifier)
compatible: "zmk,behavior-toggle-lshift"

include: zero_param.yaml
```

## dts/bindings/input_processors/zmk,input-processor-drift-filter.yaml
```yaml
description: Suppress slow one-directional drift while passing intentional movement

compatible: "zmk,input-processor-drift-filter"

include: ip_one_param.yaml
```

## dts/bindings/input_processors/zmk,input-processor-typing-guard.yaml
```yaml
# Copyright (c) 2026 The ZMK Contributors
# SPDX-License-Identifier: MIT

description: Zero out pointer movement (REL_X/REL_Y) for a window after each keypress

compatible: "zmk,input-processor-typing-guard"

include: ip_one_param.yaml
```
